## Recetas/conf/bblayers.conf
```bitbake
# POKY_BBLAYERS_CONF_VERSION is increased each time build/conf/bblayers.conf
# changes incompatibly
POKY_BBLAYERS_CONF_VERSION = "2"

BBPATH = "${TOPDIR}"
BBFILES ?= ""

BBLAYERS ?= " \
  /home/cvarela/poky/meta \
  /home/cvarela/poky/meta-poky \
  /home/cvarela/poky/meta-yocto-bsp \
  /home/cvarela/poky/meta-raspberrypi \
  /home/cvarela/poky/meta-openembedded/meta-oe \
  /home/cvarela/poky/meta-openembedded/meta-python\
  /home/cvarela/poky/meta-openembedded/meta-networking\
  /home/cvarela/poky/meta-openembedded/meta-multimedia\
  /home/cvarela/poky/meta-appreconocimiento\
  /home/cvarela/poky/meta-tensorflow-lite\
  "
```

## Recetas/meta-appreconocimiento/conf/layer.conf
```bitbake
# We have a conf and classes directory, add to BBPATH
BBPATH .= ":${LAYERDIR}"

# We have recipes-* directories, add to BBFILES
BBFILES += "${LAYERDIR}/recipes-*/*.bb \
            ${LAYERDIR}/recipes-*/*/*.bbappend"

BBFILE_COLLECTIONS += "meta-appreconocimiento"
BBFILE_PATTERN_meta-appreconocimiento = "^${LAYERDIR}/"
BBFILE_PRIORITY_meta-appreconocimiento = "6"

LAYERDEPENDS_meta-appreconocimiento = "core"
LAYERSERIES_COMPAT_meta-appreconocimiento = "honister"
```
